#include <zephyr/dt-bindings/input/input-event-codes.h>

/ {
    /omit-if-no-ref/ zip_temp_layer2: zip_temp_layer2 {
        compatible = "zmk,input-processor-temp-layer";
        #input-processor-cells = <2>;
        require-prior-idle-ms = <1000>;
        excluded-positions = <26 27 28>;
    };
};

/* 
    ╭────────────────────────┬────────────────────────╮ ╭─────────────────────────┬─────────────────────────╮
    │  0   1   2   3   4   5 │  6   7   8   9  10  11 │ │ LN5 LN4 LN3 LN2 LN1 LN0 │ RN0 RN1 RN2 RN3 RN4 RN5 │
    │ 12  13  14  15  16  17 │ 18  19  20  21  22  23 │ │ LT5 LT4 LT3 LT2 LT1 LT0 │ RT0 RT1 RT2 RT3 RT4 RT5 │
    │ 24  25  26  27  28  29 │ 30  31  32  33  34  35 │ │ LM5 LM4 LM3 LM2 LM1 LM0 │ RM0 RM1 RM2 RM3 RM4 RM5 │
    │ 36  37  38  39  40  41 │ 42  43  44  45  46  47 │ │ LB5 LB4 LB3 LB2 LB1 LB0 │ RB0 RB1 RB2 RB3 RB4 RB5 │
    ╰───────────╮ 48  49  50 │ 51  52  53 ╭───────────╯ ╰───────────╮ LH2 LH1 LH0 │ RH0 RH1 RH2 ╭───────────╯
                ╰────────────┴────────────╯                           ╰───────────┴─────────────╯
*/